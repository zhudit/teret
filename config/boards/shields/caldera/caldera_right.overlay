#include "caldera.dtsi"

&default_transform { 
    col-offset = <6>;
};

&kscan0 {
    col-gpios
        = <&pro_micro D2 GPIO_ACTIVE_HIGH>
        , <&pro_micro D7 GPIO_ACTIVE_HIGH>
        , <&pro_micro D6 GPIO_ACTIVE_HIGH>
        , <&pro_micro D5 GPIO_ACTIVE_HIGH>
        , <&pro_micro D4 GPIO_ACTIVE_HIGH>
        , <&pro_micro D3 GPIO_ACTIVE_HIGH>
        ;
};
